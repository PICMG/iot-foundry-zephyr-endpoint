## CMakeLists.txt
```
# Copyright (c) 2026 PICMG

cmake_minimum_required(VERSION 3.20.0)

find_package(Zephyr REQUIRED HINTS $ENV{ZEPHYR_BASE})

project(iot_foundry_zephyr_endpoint)

zephyr_syscall_include_directories(include)
zephyr_include_directories(include)

# Option to include PLDM support (use -DINCLUDE_PLDM=ON to enable)
option(INCLUDE_PLDM "Enable building and linking libpldm" OFF)

message(STATUS "INCLUDE_PLDM=${INCLUDE_PLDM}")

target_sources(app PRIVATE src/main.c src/mctp_control.c)

# Option to build host-only tools (like iot_builder). Disabled by default.
option(BUILD_HOST_TOOLS "Build host-only tools (not for cross/Zephyr builds)" OFF)

if(INCLUDE_PLDM)
  # Expose the option to the C compiler so `#ifdef INCLUDE_PLDM` works
  target_compile_definitions(app PRIVATE INCLUDE_PLDM=1)
  # Prefer a lightweight CMake wrapper shipped in the superproject that
  # compiles selected libpldm sources. If not present, fall back to the
  # upstream `pldm` directory (which uses Meson and may not be usable here).
  if(EXISTS "${CMAKE_CURRENT_SOURCE_DIR}/pldm-cmake/CMakeLists.txt")
    add_subdirectory("${CMAKE_CURRENT_SOURCE_DIR}/pldm-cmake")
  elseif(EXISTS "${CMAKE_CURRENT_SOURCE_DIR}/pldm/CMakeLists.txt")
    add_subdirectory("${CMAKE_CURRENT_SOURCE_DIR}/pldm")
  endif()

  if(TARGET libpldm)
    target_link_libraries(app PRIVATE libpldm)
  elseif(TARGET pldm)
    target_link_libraries(app PRIVATE pldm)
  endif()

  # -- iot_builder strict invocation (non-negotiable requirements) --
  # Per project policy: when PLDM is enabled we must run a compiled
  # iot_builder binary and fail configure immediately on any missing
  # artifact. The README documents building the host tool into
  # build-host/iot_builder/iot_builder — use that exact path.
  set(IOT_BUILDER_BIN ${CMAKE_CURRENT_SOURCE_DIR}/build-host/iot_builder/iot_builder)
  if(NOT EXISTS "${IOT_BUILDER_BIN}")
    message(FATAL_ERROR "INCLUDE_PLDM requested but iot_builder binary not found at ${IOT_BUILDER_BIN}. Build it per README before running Zephyr build.")
  endif()

  # Determine the required input JSON: it must exactly match the overlay/.conf
  # filename used for the build. Use BOARD or ZEPHYR_BOARD and normalize
  # slashes to underscores to form the basename (exact match required).
  # Prefer the full Zephyr board identifier when available; it typically
  # contains the qualified name (e.g. vendor/part/variant). Use that to
  # produce an underscore-joined basename per policy. If ZEPHYR_BOARD is
  # not set, fall back to BOARD but still require exact matching.
  # Select which variable to use per policy:
  # - If ZEPHYR_BOARD contains '/', use it (no fallback to BOARD).
  # - Else if BOARD contains '/', use BOARD.
  # - Else if ZEPHYR_BOARD is defined, use it as-is.
  # - Else if BOARD is defined, use it as-is.
  # - Otherwise fatal.
  # Use BOARD if present, else fall back to ZEPHYR_BOARD. Then, if the chosen
  # value contains '/', replace '/' with '_' to create the JSON basename.
  if(DEFINED BOARD)
    set(IOT_BOARD_RAW ${BOARD})
  elseif(DEFINED ZEPHYR_BOARD)
    set(IOT_BOARD_RAW ${ZEPHYR_BOARD})
  else()
    message(FATAL_ERROR "INCLUDE_PLDM requested but neither BOARD nor ZEPHYR_BOARD is defined; cannot determine boards/<name>.json")
  endif()

  # If the chosen value contains '/', convert tokens to underscores; otherwise use unchanged.
  string(FIND "${IOT_BOARD_RAW}" "/" _has_slash)
  if(NOT _has_slash EQUAL -1)
    # Split the qualified board identifier into parts.
    string(REPLACE "/" ";" _iot_parts ${IOT_BOARD_RAW})
    list(LENGTH _iot_parts _iot_parts_count)

    # If BOARD_DIR is available, use its basename as the vendor prefix
    # and join the remaining BOARD tokens with underscores. This yields
    # names like vendor_part_variant -> nrf54l15dk_nrf54l15_cpuapp.
    if(DEFINED BOARD_DIR)
      get_filename_component(_board_dir_basename ${BOARD_DIR} NAME)
      list(GET _iot_parts 0 _first_part)
      if(_first_part STREQUAL _board_dir_basename)
        list(REMOVE_AT _iot_parts 0)
        if(_iot_parts)
          list(JOIN _iot_parts "_" _rest)
          set(IOT_BOARD_BASENAME ${_board_dir_basename}_${_rest})
        else()
          set(IOT_BOARD_BASENAME ${_board_dir_basename})
        endif()
      else()
        # If the first token doesn't match the BOARD_DIR basename, join all parts.
        list(JOIN _iot_parts "_" IOT_BOARD_BASENAME)
      endif()
    else()
      # No BOARD_DIR available; join all parts as a fallback.
      list(JOIN _iot_parts "_" IOT_BOARD_BASENAME)
    endif()
  else()
    set(IOT_BOARD_BASENAME ${IOT_BOARD_RAW})
  endif()
  message(STATUS "IOT_BOARD_RAW='${IOT_BOARD_RAW}'")
  message(STATUS "IOT_BOARD_BASENAME='${IOT_BOARD_BASENAME}'")
  set(IOT_BUILDER_INPUT ${CMAKE_CURRENT_SOURCE_DIR}/boards/${IOT_BOARD_BASENAME}.json)
  if(NOT EXISTS "${IOT_BUILDER_INPUT}")
    # If the exact basename file is missing, and the original BOARD value
    # did not contain slashes, attempt to locate a single candidate that
    # starts with the board dirname as a prefix (e.g. nrf54l15dk_*.json).
    string(FIND "${IOT_BOARD_RAW}" "/" _orig_has_slash)
    if(_orig_has_slash EQUAL -1)
      file(GLOB _iot_candidates RELATIVE ${CMAKE_CURRENT_SOURCE_DIR}/boards "${CMAKE_CURRENT_SOURCE_DIR}/boards/${IOT_BOARD_RAW}_*.json")
      list(LENGTH _iot_candidates _cnt)
      if(_cnt EQUAL 1)
        list(GET _iot_candidates 0 _sel)
        set(IOT_BUILDER_INPUT ${CMAKE_CURRENT_SOURCE_DIR}/boards/${_sel})
        message(STATUS "Selected builder input via single-prefix match: ${IOT_BUILDER_INPUT}")
      else()
        message(FATAL_ERROR "INCLUDE_PLDM requested but required input JSON not found: ${IOT_BUILDER_INPUT} (also found ${_cnt} prefix candidates)")
      endif()
    else()
      message(FATAL_ERROR "INCLUDE_PLDM requested but required input JSON not found: ${IOT_BUILDER_INPUT}")
    endif()
  endif()

  # Ensure output directory exists and run the builder at configure time.
  file(MAKE_DIRECTORY ${CMAKE_CURRENT_SOURCE_DIR}/src/pldms)
  execute_process(
    COMMAND "${IOT_BUILDER_BIN}" "${IOT_BUILDER_INPUT}" "${CMAKE_CURRENT_SOURCE_DIR}/src/pdrs/"
    WORKING_DIRECTORY ${CMAKE_CURRENT_SOURCE_DIR}
    RESULT_VARIABLE _IOT_BUILDER_EXIT
    OUTPUT_VARIABLE _IOT_BUILDER_OUT
    ERROR_VARIABLE _IOT_BUILDER_ERR
    OUTPUT_STRIP_TRAILING_WHITESPACE
    ERROR_STRIP_TRAILING_WHITESPACE
  )
  if(NOT _IOT_BUILDER_EXIT EQUAL 0)
    message(FATAL_ERROR "iot_builder failed (exit ${_IOT_BUILDER_EXIT}): ${_IOT_BUILDER_ERR}")
  endif()


  # Add platform handler sources and FRU implementation into the Zephyr app
  # when PLDM support is enabled. Use CONFIGURE_DEPENDS so CMake re-globs
  # when files are added/removed during development.
  file(GLOB PLATFORM_SRCS CONFIGURE_DEPENDS
    ${CMAKE_CURRENT_SOURCE_DIR}/src/process_pldm.c
    ${CMAKE_CURRENT_SOURCE_DIR}/src/platform_*.c
    ${CMAKE_CURRENT_SOURCE_DIR}/src/fru.c
    ${CMAKE_CURRENT_SOURCE_DIR}/src/build_timestamp.c
  )
  if(PLATFORM_SRCS)
    target_sources(app PRIVATE ${PLATFORM_SRCS})
  endif()
endif()

# after project(...) include the platform-specific PDR source files
if(INCLUDE_PLDM)
    file(GLOB PDR_SRCS CONFIGURE_DEPENDS ${CMAKE_CURRENT_SOURCE_DIR}/src/pdrs/*.c)
    if(PDR_SRCS)
    target_sources(app PRIVATE ${PDR_SRCS})
    endif()
endif()

# If requested, build host tools (iot_builder) for native Linux only
if(BUILD_HOST_TOOLS AND NOT CMAKE_CROSSCOMPILING)
  if(EXISTS "${CMAKE_CURRENT_SOURCE_DIR}/tools/iot_builder/CMakeLists.txt")
    add_subdirectory(${CMAKE_CURRENT_SOURCE_DIR}/tools/iot_builder ${CMAKE_BINARY_DIR}/tools/iot_builder_build)
    if(TARGET iot_builder)
      # Ensure the Zephyr app depends on generator outputs if the tool provides a gen target
      if(TARGET iot_builder_gen)
        add_dependencies(app iot_builder_gen)
      endif()
    endif()
  endif()
endif()
```

## west.yml
```
manifest:
  remotes:
    - name: zephyrproject-rtos
      url-base: https://github.com/zephyrproject-rtos

  projects:
    - name: zephyr
      remote: zephyrproject-rtos
      revision: main
      import:
        name-allowlist:
          - libmctp
          - hal_atmel
          - hal_nordic
```

## prj.conf
```kconfig
CONFIG_SERIAL=y
CONFIG_UART_ASYNC_API=y
CONFIG_MCTP=y
CONFIG_MCTP_UART=y
CONFIG_LOG=y
CONFIG_LOG_BUFFER_SIZE=1024
CONFIG_ISR_STACK_SIZE=4096
```

## boards/nrf54l15dk_nrf54l15_cpuapp.conf
```kconfig
CONFIG_SERIAL=y
CONFIG_UART_ASYNC_API=y
CONFIG_MCTP=y
CONFIG_MCTP_UART=y
#CONFIG_LOG=y
#CONFIG_LOG_BACKEND_UART=y
#CONFIG_UART_CONSOLE=y
```

## boards/nrf54l15dk_nrf54l15_cpuapp.overlay
```dts
arduino_serial: &uart20 {
    current-speed = <115200>;
    status = "okay";
};
```

## src/main.c
```c
/**
 * @file main.c
 * @brief Zephyr Endpoint for IoT-Foundry project
 * This is a simple MCTP endpoint implementation using Zephyr RTOS.
 * It uses MCTP over UART for communication and handles basic
 * MCTP control messages such as Get Endpoint ID.
 * @author Doug Sandy
 * @date January 2026
 */

#include <stdlib.h>
#include <stdio.h>
#include <assert.h>
#include <zephyr/kernel.h>
#include <zephyr/types.h>
#include <zephyr/pmci/mctp/mctp_uart.h>
#include <libmctp.h>
#include <zephyr/drivers/uart.h>
#include <zephyr/devicetree.h>
#include <zephyr/drivers/gpio.h>
#include <zephyr/logging/log.h>
#include "mctp_control.h"
#include "process_pldm.h"

LOG_MODULE_REGISTER(mctp_endpoint, LOG_LEVEL_DBG);

/* Duplicate of libmctp control header structures/macros.
 * These are intentionally local copies for development/testing when
 * the upstream libmctp headers are not available on the include path.
 */
struct mctp_ctrl_msg_hdr {
	uint8_t ic_msg_type;
	uint8_t rq_dgram_inst;
	uint8_t command_code;
} __packed;

#define MCTP_CTRL_HDR_MSG_TYPE	       0
#define MCTP_CTRL_HDR_FLAG_REQUEST     (1 << 7)
#define MCTP_CTRL_HDR_FLAG_DGRAM       (1 << 6)
#define MCTP_CTRL_HDR_INSTANCE_ID_MASK 0x1F

#define ECHO_Q_DEPTH 4
#define RX_BUF_SZ 256

struct echo_msg {
	uint8_t remote_eid;
	uint8_t destination_eid;
	bool tag_owner;
	uint8_t msg_tag;
	size_t len;
	uint8_t data[RX_BUF_SZ];
};

// message queue for received echo messages
K_MSGQ_DEFINE(echo_q, sizeof(struct echo_msg), ECHO_Q_DEPTH, 4);

// define the MCTP UART binding
MCTP_UART_DT_DEFINE(mctp_endpoint, DEVICE_DT_GET(DT_NODELABEL(arduino_serial)));

/**
 * @brief MCTP receive message handler
 * Handles incoming MCTP messages by enqueueing them for processing.
 * @param remote_eid The source endpoint ID of the message sender.
 * @param tag_owner The tag owner bit of the message.
 * @param msg_tag The message tag of the message.
 * @param data Pointer to user data (not used).
 * @param msg Pointer to the full message including header.
 * @param len Length of the message in bytes.
 */
static void rx_message(uint8_t remote_eid, bool tag_owner, uint8_t msg_tag, void *data, void *msg, size_t len)
{
	struct echo_msg emsg;

	// ignore non requests
	if (!tag_owner) {
		return;
	}

	emsg.remote_eid = remote_eid;
	emsg.tag_owner = !tag_owner; /* reply toggles tag owner */
	emsg.msg_tag = msg_tag;
	emsg.len = MIN(len, (size_t)RX_BUF_SZ);
	if (msg && emsg.len) {
		memcpy(emsg.data, msg, emsg.len);
	}

	k_msgq_put(&echo_q, &emsg, K_NO_WAIT); 
}

/**
 * @brief Main function
 * Initializes MCTP over UART and enters the main processing loop.
 */
int main(void)
{
	LOG_INF("mctp_endpoint: main() start");

	mctp_set_alloc_ops(malloc, free, realloc);
	
	// initialize MCTP
	struct mctp *mctp_ctx = mctp_init();
	__ASSERT_NO_MSG(mctp_ctx != NULL);

	// Initialize the versions map (versions of supported MCTP message types) 
	initialize_versions_map();

	// set the mctp bus binding for our uart - initial EID 0x00 (unconfigured)
	mctp_register_bus(mctp_ctx, &mctp_endpoint.binding, 0x00);
	
	// set the default rx message handler
	mctp_set_rx_all(mctp_ctx, rx_message, NULL);

	/* MCTP poll loop: dequeue echo messages and send replies from thread context */
	mctp_uart_start_rx(&mctp_endpoint);

#ifdef INCLUDE_PLDM
	// Initialize the PLDM processing module
	init_pldm();
	LOG_DBG("PLDM processing initialized");
#endif

	struct echo_msg em;
	while (true) {
		if (k_msgq_get(&echo_q, &em, K_FOREVER) == 0) {		
			const struct mctp_ctrl_msg_hdr *hdr = (const struct mctp_ctrl_msg_hdr *)em.data;
			if ((em.len >= sizeof(struct mctp_ctrl_msg_hdr)) && 
				(hdr->ic_msg_type == MCTP_CTRL_HDR_MSG_TYPE)) {
				// this is a control message - process it
				int ret = send_control_message(mctp_ctx, em.remote_eid, em.tag_owner, em.msg_tag, em.data, em.len);
				if (ret) {
					LOG_DBG("send_control_message failed: %d", ret);
				}
			} 
#ifdef INCLUDE_PLDM
			// process pldm messages if libpldm is included
			else if ((em.len >= sizeof(struct mctp_ctrl_msg_hdr)) && 
				(hdr->ic_msg_type == MCTP_PLDM_HDR_MSG_TYPE)) {
				// this is a PLDM message - process it
				handle_pldm_message(mctp_ctx, em.remote_eid, em.tag_owner, em.msg_tag, em.data, em.len);
			}
#endif
			else {
				LOG_WRN("unknown message type, dropping");
				continue;
			}			
		}
	}

	return 0;
}
```

## src/build_timestamp.c
```c
/**
 * @file build_timestamp.c
 * @brief Build-time timestamp derived from __DATE__ and __TIME__
 *
 * Produces a 13-byte PLDM TIMESTAMP104 value: 8-byte little-endian
 * seconds since epoch followed by 5 zero bytes. The compile-time
 * macros __DATE__ and __TIME__ are parsed to construct the UTC
 * timestamp.
 */
#include <stdint.h>
#include <string.h>
#include "platform.h"
#include <stdio.h>

/* Convert 3-letter month to month number (1-12) */
static int month_str_to_num(const char *m)
{
    if (memcmp(m, "Jan", 3) == 0) return 1;
    if (memcmp(m, "Feb", 3) == 0) return 2;
    if (memcmp(m, "Mar", 3) == 0) return 3;
    if (memcmp(m, "Apr", 3) == 0) return 4;
    if (memcmp(m, "May", 3) == 0) return 5;
    if (memcmp(m, "Jun", 3) == 0) return 6;
    if (memcmp(m, "Jul", 3) == 0) return 7;
    if (memcmp(m, "Aug", 3) == 0) return 8;
    if (memcmp(m, "Sep", 3) == 0) return 9;
    if (memcmp(m, "Oct", 3) == 0) return 10;
    if (memcmp(m, "Nov", 3) == 0) return 11;
    if (memcmp(m, "Dec", 3) == 0) return 12;
    return 0;
}

/* days_from_civil: convert civil date to days since Unix epoch (1970-01-01)
 * Implementation based on Howard Hinnant's algorithm (portable, handles
 * Gregorian proleptic calendar).
 */
static int64_t days_from_civil(int y, unsigned m, unsigned d)
{
    y -= m <= 2;
    const int era = (y >= 0 ? y : y - 399) / 400;
    const unsigned yoe = (unsigned)(y - era * 400);
    const unsigned doy = (153 * (m + (m > 2 ? -3 : 9)) + 2) / 5 + d - 1;
    const unsigned doe = yoe * 365 + yoe / 4 - yoe / 100 + doy;
    return (int64_t)era * 146097 + (int64_t)doe - 719468;
}

const uint8_t *get_build_timestamp104(void)
{
    static uint8_t ts[13] = {0};
    static int initialized = 0;
    if (initialized) return ts;

    /* Parse __DATE__ "Mmm dd yyyy" and __TIME__ "hh:mm:ss" */
    const char *date = __DATE__; /* e.g. "Feb  6 2026" */
    const char *time = __TIME__; /* e.g. "14:23:05" */

    char month[4] = {0};
    int day = 0;
    int year = 0;
    int hour = 0, min = 0, sec = 0;

    /* Safe sscanf replacement: use sscanf if available */
#if defined(__STDC_LIB_EXT1__) || 1
    sscanf(date, "%3s %d %d", month, &day, &year);
    sscanf(time, "%d:%d:%d", &hour, &min, &sec);
#else
    /* Fallback naive parse (unlikely to be needed) */
    memcpy(month, date, 3);
    day = (date[4] == ' ') ? (date[5] - '0') : ((date[4]-'0')*10 + (date[5]-'0'));
    year = (date[7]-'0')*1000 + (date[8]-'0')*100 + (date[9]-'0')*10 + (date[10]-'0');
    hour = (time[0]-'0')*10 + (time[1]-'0');
    min  = (time[3]-'0')*10 + (time[4]-'0');
    sec  = (time[6]-'0')*10 + (time[7]-'0');
#endif

    int mon = month_str_to_num(month);
    if (mon < 1 || mon > 12) mon = 1;

    int64_t days = days_from_civil(year, (unsigned)mon, (unsigned)day);
    int64_t seconds = days * 86400 + (int64_t)hour * 3600 + (int64_t)min * 60 + sec;

    uint64_t s = (uint64_t)seconds;
    for (int i = 0; i < 8; ++i) {
        ts[i] = (uint8_t)((s >> (8 * i)) & 0xFF);
    }
    /* remaining 5 bytes leave as zero (subseconds/timezone/oem fields) */
    initialized = 1;
    return ts;
}
```

## src/fru.c
```c
/**
 * @file fru.c
 * @brief FRU command handlers for IoT-Foundry firmware
 *
 * This file implements the PLDM FRU command handlers
 * for the IoT-Foundry Zephyr-based MCTP endpoint firmware.
 * @author Doug Sandy
 * @date February 2026
 * SPDX-License-Identifier: Apache-2.0 
 */
#include <zephyr/types.h>
#include <libmctp.h>
#include <zephyr/logging/log.h>
#include <zephyr/kernel.h>
#include <string.h>
#include <libpldm/base.h>
#include <libpldm/platform.h>
#include <libpldm/control.h>
#include <libpldm/fru.h>
#include <libpldm/edac.h>
#include <libpldm/pdr.h>
#include <../pldm/src/control-internal.h>
#include "pdrs/config.h"
#include "mctp_control.h"
#include "platform.h"

LOG_MODULE_REGISTER(fru_cmds, LOG_LEVEL_DBG);

/* TransferOperation flags are provided by libpldm as `PLDM_XFER_*` enums.
 * Use those definitions (PLDM_XFER_FIRST_PART, PLDM_XFER_NEXT_PART, etc.)
 * to match libpldm / DSP0240 semantics for MultipartReceive.
 */

/* Simple transfer-state table for Get FRU multipart transfers */
#define FRU_XFER_TABLE_SIZE 6
struct fru_xfer_entry {
	uint32_t handle;
	uint32_t offset;
	uint32_t expiry_ms;
	bool in_use;
};
static struct fru_xfer_entry fru_xfer_table[FRU_XFER_TABLE_SIZE];
static uint32_t fru_next_handle = 1;

static void fru_xfer_cleanup_expired(void)
{
	uint32_t now = k_uptime_get_32();
	for (int i = 0; i < FRU_XFER_TABLE_SIZE; ++i) {
		if (fru_xfer_table[i].in_use && fru_xfer_table[i].expiry_ms != 0 && fru_xfer_table[i].expiry_ms <= now) {
			fru_xfer_table[i].in_use = false;
		}
	}
}

static uint32_t fru_xfer_alloc(void)
{
	fru_xfer_cleanup_expired();
	for (int i = 0; i < FRU_XFER_TABLE_SIZE; ++i) {
		if (!fru_xfer_table[i].in_use) {
			uint32_t h = ++fru_next_handle;
			if (h == 0) h = ++fru_next_handle;
			fru_xfer_table[i].handle = h | 0x80000000u;
			fru_xfer_table[i].offset = 0;
			fru_xfer_table[i].expiry_ms = k_uptime_get_32() + 60000u;
			fru_xfer_table[i].in_use = true;
			return fru_xfer_table[i].handle;
		}
	}
	return 0;
}

static struct fru_xfer_entry *fru_xfer_find(uint32_t handle)
{
	fru_xfer_cleanup_expired();
	for (int i = 0; i < FRU_XFER_TABLE_SIZE; ++i) {
		if (fru_xfer_table[i].in_use && fru_xfer_table[i].handle == handle) {
			return &fru_xfer_table[i];
		}
	}
	return NULL;
}

static void fru_xfer_free_handle(uint32_t handle)
{
	for (int i = 0; i < FRU_XFER_TABLE_SIZE; ++i) {
		if (fru_xfer_table[i].in_use && fru_xfer_table[i].handle == handle) {
			fru_xfer_table[i].in_use = false;
			return;
		}
	}
}

/**
 * @brief Handle PLDM Get FRU Record Table Metadata command
 * 
 * This function processes the PLDM Get FRU Record Table Metadata command
 * and generates an appropriate response.
 * 
 * @param hdr Pointer to the PLDM header info structure.
 * @param req_msg Pointer to the incoming PLDM request message.
 * @param req_len Length of the incoming PLDM request message.
 * @param resp Pointer to the buffer for the PLDM response message.
 * @param resp_len Pointer to the length of the response buffer; updated with actual response length
 * @return PLDM_SUCCESS on success, or appropriate PLDM error code on failure.
 */
int fru_get_metadata(struct pldm_header_info *hdr, const void *req_msg, size_t req_len, void *resp, size_t *resp_len) 
{
	if (!hdr || !resp || !resp_len) {
		return PLDM_ERROR_INVALID_DATA;
	}

	/* Retrieve counts/sizes from generated config.h macros */
#ifdef FRU_NUMBER_OF_RECORDS
	uint16_t total_table_records = (uint16_t)FRU_NUMBER_OF_RECORDS;
#else
	uint16_t total_table_records = 0;
#endif
#ifdef FRU_TOTAL_RECORD_SETS
	uint16_t total_record_set_identifiers = (uint16_t)FRU_TOTAL_RECORD_SETS;
#else
	uint16_t total_record_set_identifiers = 0;
#endif
#ifdef FRU_MAX_RECORD_SIZE
	uint32_t fru_table_maximum_size = (uint32_t)FRU_MAX_RECORD_SIZE;
#else
	uint32_t fru_table_maximum_size = 0;
#endif
#ifdef FRU_TOTAL_SIZE
	uint32_t fru_table_length = (uint32_t)FRU_TOTAL_SIZE;
#else
	uint32_t fru_table_length = 0;
#endif

	/* Compute integrity checksum over the FRU Record Table bytes */
	uint32_t checksum = 0;
	if (fru_table_length > 0) {
		checksum = pldm_edac_crc32((const void *)__fru_data, (size_t)fru_table_length);
	}

	/* FRU table data version: builder/runtime convention — use 1.0 */
	uint8_t fru_data_major_version = 1;
	uint8_t fru_data_minor_version = 0;

	/* Build PLDM response using libpldm helper */
	PLDM_MSG_BUFFER(msg_buf, MCTP_PAYLOAD_MAX);
	memset(msg_buf, 0, sizeof(msg_buf));
	struct pldm_msg *msg = (struct pldm_msg *)msg_buf;
	int rc = encode_get_fru_record_table_metadata_resp(hdr->instance, PLDM_SUCCESS, fru_data_major_version, fru_data_minor_version, fru_table_maximum_size, fru_table_length, total_record_set_identifiers, total_table_records, checksum, msg);
	if (rc != PLDM_SUCCESS) {
		return rc;
	}

	size_t msg_size = sizeof(struct pldm_msg_hdr) + PLDM_GET_FRU_RECORD_TABLE_METADATA_RESP_BYTES;
	if (*resp_len < msg_size) return PLDM_ERROR_INVALID_LENGTH;
	memcpy(resp, msg, msg_size);
	*resp_len = msg_size;
	return PLDM_SUCCESS;
}

/**
 * @brief Handle PLDM Get FRU Record Table command
 * 
 * This function processes the PLDM Get FRU Record Table command
 * and generates an appropriate response.
 * 
 * @param hdr Pointer to the PLDM header info structure.
 * @param req_msg Pointer to the incoming PLDM request message.
 * @param req_len Length of the incoming PLDM request message.
 * @param resp Pointer to the buffer for the PLDM response message.
 * @param resp_len Pointer to the length of the response buffer; updated with actual response length
 * @return PLDM_SUCCESS on success, or appropriate PLDM error code on failure.
 */
int fru_get_record_table(struct pldm_header_info *hdr, const void *req_msg, size_t req_len, void *resp, size_t *resp_len)
{
	if (!hdr || !req_msg || !resp || !resp_len) {
		return PLDM_ERROR_INVALID_DATA;
	}

	const struct pldm_msg *req = req_msg;
	uint32_t data_transfer_hndl = 0;
	uint8_t transfer_op_flag = 0;

	/* Clamp payload length passed to libpldm decoder to the defined request size
	 * to avoid libpldm returning PLDM_ERROR_INVALID_LENGTH when callers pass
	 * padded or larger buffers. */
	size_t payload_len = 0;
	if (req_len > sizeof(struct pldm_msg_hdr))
		payload_len = req_len - sizeof(struct pldm_msg_hdr);
	if (payload_len > PLDM_GET_FRU_RECORD_TABLE_REQ_BYTES)
		payload_len = PLDM_GET_FRU_RECORD_TABLE_REQ_BYTES;
	int rc = decode_get_fru_record_table_req(req, payload_len, &data_transfer_hndl, &transfer_op_flag);
	if (rc != PLDM_SUCCESS) {
		/* encode error completion-only response */
		PLDM_MSG_BUFFER(msg_buf, MCTP_PAYLOAD_MAX);
		memset(msg_buf, 0, sizeof(msg_buf));
		struct pldm_msg *msg = (struct pldm_msg *)msg_buf;
		int enc = encode_get_fru_record_table_resp(hdr->instance, (uint8_t)rc, 0, PLDM_PLATFORM_TRANSFER_START_AND_END, msg);
		if (enc != PLDM_SUCCESS) return enc;
		size_t msg_sz = sizeof(struct pldm_msg_hdr) + PLDM_GET_FRU_RECORD_TABLE_MIN_RESP_BYTES;
		if (*resp_len < msg_sz) return PLDM_ERROR_INVALID_LENGTH;
		memcpy(resp, msg, msg_sz);
		*resp_len = msg_sz;
		return rc;
	}

	const uint8_t *table = (const uint8_t *)__fru_data;
	size_t table_len = (size_t)FRU_TOTAL_SIZE;

	/* Compute available payload for 'data' (excluding PLDM header and fixed resp fields),
	 * and reserve 4 bytes for the PLDM DataIntegrityChecksum which must be appended
	 * for every data part. We also reserve space for an optional 4-byte FRU CRC when
	 * sending the final fragment of a multipart transfer.
	 */
	size_t base_overhead = sizeof(struct pldm_msg_hdr) + (sizeof(struct pldm_get_fru_record_table_resp) - 1);
	size_t max_payload = (size_t)MCTP_PAYLOAD_MAX - 1; /* leading MCTP type byte */
	if (max_payload <= base_overhead + sizeof(uint32_t)) return PLDM_ERROR; /* no room for data+checksum */
	size_t avail_data = max_payload - base_overhead - sizeof(uint32_t); /* space for data, excluding PLDM DataIntegrityChecksum */

	uint32_t returned_next_transfer_handle = 0;
	uint8_t transfer_flag = PLDM_PLATFORM_TRANSFER_START_AND_END;
	size_t transfer_offset = 0;
	size_t data_len = 0;
	uint32_t fru_payload_crc = 0; /* FRUDataStructureIntegrityChecksum if appended */
	const size_t fru_crc_size = FRU_TABLE_CHECKSUM_SIZE;

	/* Validate transfer operation flags per PLDM Get semantics */
	if (data_transfer_hndl == 0) {
		if (transfer_op_flag != PLDM_XFER_FIRST_PART) {
			PLDM_MSG_BUFFER(msg_buf, MCTP_PAYLOAD_MAX);
			memset(msg_buf, 0, sizeof(msg_buf));
			struct pldm_msg *msg = (struct pldm_msg *)msg_buf;
			int enc = encode_get_fru_record_table_resp(hdr->instance, PLDM_FRU_INVALID_TRANSFER_FLAG, 0, PLDM_PLATFORM_TRANSFER_START_AND_END, msg);
			if (enc != PLDM_SUCCESS) return enc;
			size_t msg_sz = sizeof(struct pldm_msg_hdr) + PLDM_GET_FRU_RECORD_TABLE_MIN_RESP_BYTES;
			if (*resp_len < msg_sz) return PLDM_ERROR_INVALID_LENGTH;
			memcpy(resp, msg, msg_sz);
			*resp_len = msg_sz;
			return PLDM_FRU_INVALID_TRANSFER_FLAG;
		}

		/* Decide whether the whole table fits in one response (single-part).
		 * Single-part replies MUST include the PLDM DataIntegrityChecksum but
		 * MUST NOT append the FRU payload CRC-32 per DSP0257.
		 */
		if (table_len <= avail_data) {
			transfer_flag = PLDM_PLATFORM_TRANSFER_START_AND_END;
			returned_next_transfer_handle = 0;
			transfer_offset = 0;
			data_len = table_len;
			fru_payload_crc = 0; /* not appended for single-frame */
		} else {
			/* multipart: allocate a transfer handle and send the first chunk */
			uint32_t h = fru_xfer_alloc();
			if (h == 0) return PLDM_ERROR; /* no resources */
			transfer_flag = PLDM_PLATFORM_TRANSFER_START;
			returned_next_transfer_handle = h;
			transfer_offset = 0;
			data_len = avail_data; /* send as much as fits (dataIntegrityChecksum appended separately) */
			fru_payload_crc = 0;
			/* record offset for continuation */
			struct fru_xfer_entry *ne = fru_xfer_find(returned_next_transfer_handle);
			if (ne) {
				ne->offset = transfer_offset + data_len;
				ne->expiry_ms = k_uptime_get_32() + 60000u;
			}
		}
	} else {
		/* Continuation: expect GetNextPart */
		if (transfer_op_flag != PLDM_XFER_NEXT_PART) {
			PLDM_MSG_BUFFER(msg_buf, MCTP_PAYLOAD_MAX);
			memset(msg_buf, 0, sizeof(msg_buf));
			struct pldm_msg *msg = (struct pldm_msg *)msg_buf;
			int enc = encode_get_fru_record_table_resp(hdr->instance, PLDM_FRU_INVALID_TRANSFER_FLAG, 0, PLDM_PLATFORM_TRANSFER_START_AND_END, msg);
			if (enc != PLDM_SUCCESS) return enc;
			size_t msg_sz = sizeof(struct pldm_msg_hdr) + PLDM_GET_FRU_RECORD_TABLE_MIN_RESP_BYTES;
			if (*resp_len < msg_sz) return PLDM_ERROR_INVALID_LENGTH;
			memcpy(resp, msg, msg_sz);
			*resp_len = msg_sz;
			return PLDM_FRU_INVALID_TRANSFER_FLAG;
		}

		struct fru_xfer_entry *e = fru_xfer_find(data_transfer_hndl);
		if (!e) {
			PLDM_MSG_BUFFER(msg_buf, MCTP_PAYLOAD_MAX);
			memset(msg_buf, 0, sizeof(msg_buf));
			struct pldm_msg *msg = (struct pldm_msg *)msg_buf;
			int enc = encode_get_fru_record_table_resp(hdr->instance, PLDM_FRU_INVALID_DATA_TRANSFER_HANDLE, 0, PLDM_PLATFORM_TRANSFER_START_AND_END, msg);
			if (enc != PLDM_SUCCESS) return enc;
			size_t msg_sz = sizeof(struct pldm_msg_hdr) + PLDM_GET_FRU_RECORD_TABLE_MIN_RESP_BYTES;
			if (*resp_len < msg_sz) return PLDM_ERROR_INVALID_LENGTH;
			memcpy(resp, msg, msg_sz);
			*resp_len = msg_sz;
			return PLDM_FRU_INVALID_DATA_TRANSFER_HANDLE;
		}

		transfer_offset = e->offset;
		size_t remaining = (transfer_offset < table_len) ? (table_len - transfer_offset) : 0;
		if (remaining == 0) {
			/* Nothing left: return an empty success START_AND_END */
			PLDM_MSG_BUFFER(msg_buf, MCTP_PAYLOAD_MAX);
			memset(msg_buf, 0, sizeof(msg_buf));
			struct pldm_msg *msg = (struct pldm_msg *)msg_buf;
			int enc = encode_get_fru_record_table_resp(hdr->instance, PLDM_SUCCESS, 0, PLDM_PLATFORM_TRANSFER_START_AND_END, msg);
			if (enc != PLDM_SUCCESS) return enc;
			size_t msg_sz = sizeof(struct pldm_msg_hdr) + PLDM_GET_FRU_RECORD_TABLE_MIN_RESP_BYTES;
			if (*resp_len < msg_sz) return PLDM_ERROR_INVALID_LENGTH;
			memcpy(resp, msg, msg_sz);
			*resp_len = msg_sz;
			return PLDM_SUCCESS;
		}

		/* Compute pad bytes for FRU CRC alignment (0..3) based on total FRU table length */
		size_t pad_bytes = 0;
		if (table_len % 4 != 0) pad_bytes = 4 - (table_len % 4);

		/* If remaining fits including the pad and FRU payload CRC then this is END */
		if (remaining + pad_bytes + fru_crc_size <= avail_data) {
			transfer_flag = PLDM_PLATFORM_TRANSFER_END;
			returned_next_transfer_handle = 0;
			data_len = remaining;
			/* FRU payload CRC is computed over the entire table */
			fru_payload_crc = pldm_edac_crc32(table, table_len);
			fru_xfer_free_handle(e->handle);
		} else {
			transfer_flag = PLDM_PLATFORM_TRANSFER_MIDDLE;
			returned_next_transfer_handle = e->handle;
			data_len = avail_data;
			if (data_len > remaining) data_len = remaining;
			e->offset = transfer_offset + data_len;
			e->expiry_ms = k_uptime_get_32() + 60000u;
			fru_payload_crc = 0;
		}
	}

	/* Build response: encode header then copy data, optional FRU CRC (only for END), then append PLDM DataIntegrityChecksum (uint32 LE).
	 */
	PLDM_MSG_BUFFER(msg_buf, MCTP_PAYLOAD_MAX);
	memset(msg_buf, 0, sizeof(msg_buf));
	struct pldm_msg *msg = (struct pldm_msg *)msg_buf;

	rc = encode_get_fru_record_table_resp(hdr->instance, PLDM_SUCCESS, returned_next_transfer_handle, transfer_flag, msg);
	if (rc != PLDM_SUCCESS) return rc;

	/* pointer to start of variable data in encoded payload */
	struct pldm_get_fru_record_table_resp *resp_struct = (struct pldm_get_fru_record_table_resp *)msg->payload;
	uint8_t *dst = resp_struct->fru_record_table_data;

	/* copy data bytes */
	if (data_len > 0) {
		memcpy(dst, table + transfer_offset, data_len);
		dst += data_len;
	}

	/* append FRU payload CRC only for multi-part END fragments, with pad bytes preceding it */
	size_t pad_bytes = 0;
	if (transfer_flag == PLDM_PLATFORM_TRANSFER_END && fru_payload_crc != 0) {
		/* pad is computed from the full FRU table length to align the FRU CRC */
		if (table_len % 4 != 0) pad_bytes = 4 - (table_len % 4);
		if (pad_bytes > 0) {
			memset(dst, 0x00, pad_bytes);
			dst += pad_bytes;
		}
		uint32_t c = htole32(fru_payload_crc);
		memcpy(dst, &c, sizeof(c));
		dst += sizeof(c);
	}

	/* compute PLDM DataIntegrityChecksum over the DATA bytes only (exclude appended FRU CRC)
	 * That is, checksum over table[0 .. transfer_offset+data_len-1]
	 */
	uint32_t data_integrity = 0;
	if ((transfer_offset + data_len) > 0) {
		data_integrity = pldm_edac_crc32(table, transfer_offset + data_len);
	}
	uint32_t di_le = htole32(data_integrity);
	memcpy(dst, &di_le, sizeof(di_le));
	dst += sizeof(di_le);

	/* compute final message size and ensure it fits */
	size_t msg_size = sizeof(struct pldm_msg_hdr) + (sizeof(struct pldm_get_fru_record_table_resp) - 1) + data_len + ((transfer_flag == PLDM_PLATFORM_TRANSFER_END && fru_payload_crc != 0) ? (pad_bytes + fru_crc_size) : 0) + sizeof(uint32_t);

	/* If it doesn't fit in MCTP_PAYLOAD_MAX, trim data_len and re-encode loop similar to platform_pdr logic */
	while ((1 + msg_size) > MCTP_PAYLOAD_MAX) {
		if (data_len == 0) return PLDM_ERROR; /* cannot fit */
		/* shrink by one and recompute semantics */
		data_len--;
		/* if we shrank below end threshold, switch to MIDDLE and remove FRU CRC */
		if (transfer_flag == PLDM_PLATFORM_TRANSFER_END && (transfer_offset + data_len) < table_len) {
			transfer_flag = PLDM_PLATFORM_TRANSFER_MIDDLE;
			fru_payload_crc = 0;
			returned_next_transfer_handle = fru_xfer_alloc();
			if (returned_next_transfer_handle == 0) return PLDM_ERROR;
			struct fru_xfer_entry *ne = fru_xfer_find(returned_next_transfer_handle);
			if (ne) {
				ne->offset = transfer_offset + data_len;
				ne->expiry_ms = k_uptime_get_32() + 60000u;
			}
		}

		/* re-encode header and copy trimmed data */
		memset(msg_buf, 0, sizeof(msg_buf));
		rc = encode_get_fru_record_table_resp(hdr->instance, PLDM_SUCCESS, returned_next_transfer_handle, transfer_flag, msg);
		if (rc != PLDM_SUCCESS) return rc;
		resp_struct = (struct pldm_get_fru_record_table_resp *)msg->payload;
		dst = resp_struct->fru_record_table_data;
		if (data_len > 0) memcpy(dst, table + transfer_offset, data_len);
		if (transfer_flag == PLDM_PLATFORM_TRANSFER_END && fru_payload_crc != 0) {
			/* recompute pad for trimmed data and append pad + FRU CRC */
			size_t pad_trim = 0;
			if (table_len % 4 != 0) pad_trim = 4 - (table_len % 4);
			if (pad_trim > 0) memset(dst + data_len, 0x00, pad_trim);
			uint32_t c = htole32(fru_payload_crc);
			memcpy(dst + data_len + pad_trim, &c, sizeof(c));
		}
		/* recompute data_integrity over table up to new length */
		if ((transfer_offset + data_len) > 0) data_integrity = pldm_edac_crc32(table, transfer_offset + data_len);
		uint32_t di_le2 = htole32(data_integrity);
		memcpy(dst + data_len + ((transfer_flag == PLDM_PLATFORM_TRANSFER_END && fru_payload_crc != 0) ? ((table_len % 4 != 0 ? 4 - (table_len % 4) : 0) + fru_crc_size) : 0), &di_le2, sizeof(di_le2));
		msg_size = sizeof(struct pldm_msg_hdr) + (sizeof(struct pldm_get_fru_record_table_resp) - 1) + data_len + ((transfer_flag == PLDM_PLATFORM_TRANSFER_END && fru_payload_crc != 0) ? ((table_len % 4 != 0 ? 4 - (table_len % 4) : 0) + fru_crc_size) : 0) + sizeof(uint32_t);
	}

	if (*resp_len < msg_size) return PLDM_ERROR_INVALID_LENGTH;
	memcpy(resp, msg, msg_size);

	/* If we allocated a transfer handle for a START fragment, update its offset */
	if (returned_next_transfer_handle != 0 && transfer_flag == PLDM_PLATFORM_TRANSFER_START) {
		struct fru_xfer_entry *ne = fru_xfer_find(returned_next_transfer_handle);
		if (ne) {
			ne->offset = data_len;
			ne->expiry_ms = k_uptime_get_32() + 60000u;
		}
	}

	*resp_len = msg_size;
	return PLDM_SUCCESS;

}

/**
 * @brief Handle PLDM Set FRU Record Table command
 * 
 * This function processes the PLDM Set FRU Record Table command
 * and generates an appropriate response.
 * 
 * @param hdr Pointer to the PLDM header info structure.
 * @param req_msg Pointer to the incoming PLDM request message.
 * @param req_len Length of the incoming PLDM request message.
 * @param resp Pointer to the buffer for the PLDM response message.
 * @param resp_len Pointer to the length of the response buffer; updated with actual response length
 * @return PLDM_SUCCESS on success, or appropriate PLDM error code on failure.
 */
int fru_set_record_table(struct pldm_header_info *hdr, const void *req_msg, size_t req_len, void *resp, size_t *resp_len) {
        if (hdr == NULL || req_msg == NULL || resp == NULL || resp_len == NULL) {
                return PLDM_ERROR_INVALID_DATA;
        }

        PLDM_MSG_BUFFER(msg_buf, MCTP_PAYLOAD_MAX);
        memset(msg_buf, 0, sizeof(msg_buf));
        struct pldm_msg *msg = (struct pldm_msg *)msg_buf;
		struct pldm_header_info header = {0};
        header.msg_type = PLDM_RESPONSE;
        header.instance = hdr->instance;
		header.pldm_type = PLDM_FRU;
        header.command = PLDM_SET_FRU_RECORD_TABLE;
        if (pack_pldm_header(&header, &msg->hdr) != PLDM_SUCCESS) return PLDM_ERROR;
        msg->payload[0] = PLDM_ERROR_UNSUPPORTED_PLDM_CMD;
        size_t msg_sz = sizeof(struct pldm_msg_hdr) + 1;
        if (*resp_len < msg_sz) return PLDM_ERROR_INVALID_LENGTH;
        memcpy(resp, msg, msg_sz);
        *resp_len = msg_sz;
        return PLDM_ERROR_UNSUPPORTED_PLDM_CMD;
}

/**
 * @brief Handle PLDM Get FRU Record By Option command
 * 
 * This function processes the PLDM Get FRU Record By Option command
 * and generates an appropriate response.
 * 
 * @param hdr Pointer to the PLDM header info structure.
 * @param req_msg Pointer to the incoming PLDM request message.
 * @param req_len Length of the incoming PLDM request message.
 * @param resp Pointer to the buffer for the PLDM response message.
 * @param resp_len Pointer to the length of the response buffer; updated with actual response length
 * @return PLDM_SUCCESS on success, or appropriate PLDM error code on failure.
 */
int fru_get_record_by_option(struct pldm_header_info *hdr, const void *req_msg, size_t req_len, void *resp, size_t *resp_len) {
        if (hdr == NULL || req_msg == NULL || resp == NULL || resp_len == NULL) {
                return PLDM_ERROR_INVALID_DATA;
        }

        PLDM_MSG_BUFFER(msg_buf, MCTP_PAYLOAD_MAX);
        memset(msg_buf, 0, sizeof(msg_buf));
        struct pldm_msg *msg = (struct pldm_msg *)msg_buf;
		struct pldm_header_info header = {0};
        header.msg_type = PLDM_RESPONSE;
        header.instance = hdr->instance;
		header.pldm_type = PLDM_FRU;
        header.command = PLDM_GET_FRU_RECORD_BY_OPTION;
        if (pack_pldm_header(&header, &msg->hdr) != PLDM_SUCCESS) return PLDM_ERROR;
        msg->payload[0] = PLDM_ERROR_UNSUPPORTED_PLDM_CMD;
        size_t msg_sz = sizeof(struct pldm_msg_hdr) + 1;
        if (*resp_len < msg_sz) return PLDM_ERROR_INVALID_LENGTH;
        memcpy(resp, msg, msg_sz);
        *resp_len = msg_sz;
        return PLDM_ERROR_UNSUPPORTED_PLDM_CMD;
}
```

## src/mctp_control.h
```c
/**
 * @file mctp_control.h
 * @brief MCTP Control Message Handling Header
 * 
 * This header file defines the structures and function prototypes
 * for handling MCTP control messages in a Zephyr-based MCTP endpoint.
 * It includes definitions for control message types, completion codes,
 * and function declarations for processing control messages.
 * 
 * @author Doug Sandy
 * @date January 2026
 */
#ifndef MCTP_CONTROL_H
#define MCTP_CONTROL_H

#include <stdlib.h>
#ifdef MCTP_POSIX_UNIT_TEST
#include <stdint.h>
#include <stdbool.h>
#include "libmctp.h"
/* Minimal mctp struct definitions used by the control handlers (mirrors
 * internal definitions in mctp_control.c). These are provided for unit
 * tests so test code can construct a small mctp instance.
 */
struct mctp_bus {
    mctp_eid_t eid;
};

struct mctp {
    int n_busses;
    struct mctp_bus *busses;
};
/* helper macros for test builds to access EID in the minimal mctp struct */
#define GET_EID_FROM_MCTP(mctp_ptr) (((struct mctp_bus *)(mctp_ptr->busses))->eid)
#define SET_EID_IN_MCTP(mctp_ptr, new_eid) ((((struct mctp_bus *)(mctp_ptr->busses))->eid) = (new_eid))
/* prototype used by tests to stub transport */
int mctp_message_tx(struct mctp *mctp, uint8_t remote_eid, bool tag_owner, uint8_t msg_tag, const void *msg, size_t msg_len);
/* Minimal logging macros for unit tests */
#include <stdio.h>
#define LOG_MODULE_REGISTER(name, level)
#define LOG_INF(fmt, ...) printf(fmt "\n", ##__VA_ARGS__)
#define LOG_DBG(fmt, ...) printf(fmt "\n", ##__VA_ARGS__)
#define LOG_ERR(fmt, ...) printf(fmt "\n", ##__VA_ARGS__)
#else
#include <zephyr/types.h>
#include <libmctp.h>
#include <zephyr/pmci/mctp/mctp_uart.h>
#include <zephyr/logging/log.h>
#endif

#define MCTP_CTRL_HDR_MSG_TYPE      0
#define MCTP_PLDM_HDR_MSG_TYPE      1

/* control message codes */
#define CONTROL_MSG_SET_ENDPOINT_ID 0x01
#define CONTROL_MSG_GET_ENDPOINT_ID 0x02
#define CONTROL_MSG_GET_MCTP_VERSION_SUPPORT 0x04
#define CONTROL_MSG_GET_MESSAGE_TYPE_SUPPORT 0x05

/* Control message completion codes */
#define CONTROL_COMPLETE_SUCCESS 0x00
#define CONTROL_COMPLETE_ERROR 0x01
#define CONTROL_COMPLETE_INVALID_DATA 0x02
#define CONTROL_COMPLETE_INVALID_LENGTH 0x03
#define CONTROL_COMPLETE_NOT_READY 0x04
#define CONTROL_COMPLETE_UNSUPPORTED_CMD 0x05
#define CONTROL_COMPLETE_COMMAND_SPECIFIC_START 0x80
#define CONTROL_COMPLETE_COMMAND_SPECIFIC_END 0xFF

// structure for MCTP version entry
struct mctp_version_entry {
    uint8_t major_version;
    uint8_t minor_version;
    uint8_t update_version;
    uint8_t alpha_version;
} __packed;

// initialize the versions map
void initialize_versions_map(void);

// send a control message using MCTP
int send_control_message(struct mctp *mctp, uint8_t eid, bool tag_owner, uint8_t msg_tag, const void *msg, size_t msg_len);

// send control completion response
void send_completion_response(struct mctp *mctp, uint8_t remote_eid, bool tag_owner, uint8_t msg_tag, const void *msg, size_t len, uint8_t completion_code);

// add a supported version for a message type
int mctp_versions_map_add(uint8_t msg_type, const struct mctp_version_entry *ver);

// get the current endpoint ID from the MCTP instance.
uint8_t get_current_endpoint_id(struct mctp *mctp);

#endif /* MCTP_CONTROL_H */
```

## src/platform_effecter.c
```c
/**
 * @file platform_effecter.c
 * @brief Platform Effecter command handlers for IoT-Foundry firmware
 * This file implements the PLDM Platform Effecter command handlers
 * for the IoT-Foundry Zephyr-based MCTP endpoint firmware.
 * 
 * @author Doug Sandy
 * @date February 2026
 * SPDX-License-Identifier: Apache-2.0 
 */ 
#include <zephyr/types.h>
#include <libmctp.h>
#include <zephyr/logging/log.h>
#include <zephyr/kernel.h>
#include <string.h>
#include <libpldm/base.h>
#include <libpldm/platform.h>
#include <libpldm/control.h>
#include <libpldm/fru.h>
#include <libpldm/pdr.h>
#include <../pldm/src/control-internal.h>
#include "pdrs/config.h"
#include "mctp_control.h"

/**
 * @brief Handle PLDM Set Numeric Effecter Enable command
 * 
 * This function processes the PLDM Set Numeric Effecter Enable command
 * and generates an appropriate response.
 * 
 * @param hdr Pointer to the PLDM header info structure.
 * @param req_msg Pointer to the incoming PLDM request message.
 * @param req_len Length of the incoming PLDM request message.
 * @param resp Pointer to the buffer for the PLDM response message.
 * @param resp_len Pointer to the length of the response buffer; updated with actual response length
 * @return PLDM_SUCCESS on success, or appropriate PLDM error code on failure.
 */
int handle_platform_set_numeric_effecter_enable(struct pldm_header_info *hdr, const void *req_msg, size_t req_len, void *resp, size_t *resp_len)
{
	// TODO: implement
	return PLDM_ERROR_UNSUPPORTED_PLDM_CMD;
}

/**
 * @brief Handle PLDM Get Numeric Effecter Enable command 
 * 
 * This function processes the PLDM Get Numeric Effecter Enable command
 * and generates an appropriate response.
 * 
 * @param hdr Pointer to the PLDM header info structure.
 * @param req_msg Pointer to the incoming PLDM request message.
 * @param req_len Length of the incoming PLDM request message.
 * @param resp Pointer to the buffer for the PLDM response message.
 * @param resp_len Pointer to the length of the response buffer; updated with actual response length
 * @return PLDM_SUCCESS on success, or appropriate PLDM error code on failure.
 */
int handle_platform_set_numeric_effecter_value(struct pldm_header_info *hdr, const void *req_msg, size_t req_len, void *resp, size_t *resp_len)
{
	// TODO: implement
	return PLDM_ERROR_UNSUPPORTED_PLDM_CMD;
}

/**
 * @brief Handle PLDM Get Numeric Effecter Enable command
 * 
 * This function processes the PLDM Get Numeric Effecter Enable command
 * and generates an appropriate response.
 * 
 * @param hdr Pointer to the PLDM header info structure.
 * @param req_msg Pointer to the incoming PLDM request message.
 * @param req_len Length of the incoming PLDM request message.
 * @param resp Pointer to the buffer for the PLDM response message.
 * @param resp_len Pointer to the length of the response buffer; updated with actual response length
 * @return PLDM_SUCCESS on success, or appropriate PLDM error code on failure.
 */
int handle_platform_get_numeric_effecter_value(struct pldm_header_info *hdr, const void *req_msg, size_t req_len, void *resp, size_t *resp_len)
{
	// TODO: implement
	return PLDM_ERROR_UNSUPPORTED_PLDM_CMD;
}

/**
 * @brief Handle PLDM Set State Effecter Enables command
 * 
 * This function processes the PLDM Set State Effecter Enables command
 * and generates an appropriate response.
 * 
 * @param hdr Pointer to the PLDM header info structure.
 * @param req_msg Pointer to the incoming PLDM request message.
 * @param req_len Length of the incoming PLDM request message.
 * @param resp Pointer to the buffer for the PLDM response message.
 * @param resp_len Pointer to the length of the response buffer; updated with actual response length
 * @return PLDM_SUCCESS on success, or appropriate PLDM error code on failure.
 */
int handle_platform_set_state_effecter_enables(struct pldm_header_info *hdr, const void *req_msg, size_t req_len, void *resp, size_t *resp_len)
{
	// TODO: implement
	return PLDM_ERROR_UNSUPPORTED_PLDM_CMD;
}

/**
 * @brief Handle PLDM Set State Effecter States command
 * 
 * This function processes the PLDM Set State Effecter States command
 * and generates an appropriate response.
 * 
 * @param hdr Pointer to the PLDM header info structure.
 * @param req_msg Pointer to the incoming PLDM request message.
 * @param req_len Length of the incoming PLDM request message.
 * @param resp Pointer to the buffer for the PLDM response message.
 * @param resp_len Pointer to the length of the response buffer; updated with actual response length
 * @return PLDM_SUCCESS on success, or appropriate PLDM error code on failure.
 */
int handle_platform_set_state_effecter_states(struct pldm_header_info *hdr, const void *req_msg, size_t req_len, void *resp, size_t *resp_len)
{
	// TODO: implement
	return PLDM_ERROR_UNSUPPORTED_PLDM_CMD;
}

/**
 * @brief Handle PLDM Get State Effecter States command
 * 
 * This function processes the PLDM Get State Effecter States command
 * and generates an appropriate response.
 * 
 * @param hdr Pointer to the PLDM header info structure.
 * @param req_msg Pointer to the incoming PLDM request message.
 * @param req_len Length of the incoming PLDM request message.
 * @param resp Pointer to the buffer for the PLDM response message.
 * @param resp_len Pointer to the length of the response buffer; updated with actual response length
 * @return PLDM_SUCCESS on success, or appropriate PLDM error code on failure.
 */
int handle_platform_get_state_effecter_states(struct pldm_header_info *hdr, const void *req_msg, size_t req_len, void *resp, size_t *resp_len)
{
	// TODO: implement
	return PLDM_ERROR_UNSUPPORTED_PLDM_CMD;
}
```

## src/platform_statesense.c
```c
/**
 * @file platform_statesense.c
 * @brief Platform State Sensor command handlers for IoT-Foundry firmware
 *
 * This file implements the PLDM Platform State Sensor command handlers
 * for the IoT-Foundry Zephyr-based MCTP endpoint firmware.
 * 
 * @author Doug Sandy
 * @date February 2026
 * SPDX-License-Identifier: Apache-2.0 
 */
#include <zephyr/types.h>
#include <libmctp.h>
#include <zephyr/logging/log.h>
#include <zephyr/kernel.h>
#include <string.h>
#include <libpldm/base.h>
#include <libpldm/platform.h>
#include <libpldm/control.h>
#include <libpldm/fru.h>
#include <libpldm/pdr.h>
#include <../pldm/src/control-internal.h>
#include "pdrs/config.h"
#include "mctp_control.h"

LOG_MODULE_REGISTER(platform_statesense, LOG_LEVEL_DBG);

/**
 * @brief Handle PLDM Set State Sensor Enables command
 * 
 * This function processes the PLDM Set State Sensor Enables command
 * and generates an appropriate response.
 * 
 * @param hdr Pointer to the PLDM header info structure.
 * @param req_msg Pointer to the incoming PLDM request message.
 * @param req_len Length of the incoming PLDM request message.
 * @param resp Pointer to the buffer for the PLDM response message.
 * @param resp_len Pointer to the length of the response buffer; updated with actual response length
 * @return PLDM_SUCCESS on success, or appropriate PLDM error code on failure.
 */
int handle_platform_set_state_sensor_enables(struct pldm_header_info *hdr, const void *req_msg, size_t req_len, void *resp, size_t *resp_len)
{
	// TODO: implement
	return PLDM_ERROR_UNSUPPORTED_PLDM_CMD;
}

/**
 * @brief Handle PLDM Get State Sensor Readings command
 * 
 * This function processes the PLDM Get State Sensor Readings command
 * and generates an appropriate response.
 * 
 * @param hdr Pointer to the PLDM header info structure.
 * @param req_msg Pointer to the incoming PLDM request message.
 * @param req_len Length of the incoming PLDM request message.
 * @param resp Pointer to the buffer for the PLDM response message.
 * @param resp_len Pointer to the length of the response buffer; updated with actual response length
 * @return PLDM_SUCCESS on success, or appropriate PLDM error code on failure.
 */
int handle_platform_get_state_sensor_readings(struct pldm_header_info *hdr, const void *req_msg, size_t req_len, void *resp, size_t *resp_len)
{
	// TODO: implement
	return PLDM_ERROR_UNSUPPORTED_PLDM_CMD;
}

/**
 * @brief Handle PLDM Init State Sensor command
 *
 * This function processes the PLDM Init State Sensor command
 * and generates an appropriate response.
 * 
 * @param hdr Pointer to the PLDM header info structure.
 * @param req_msg Pointer to the incoming PLDM request message.
 * @param req_len Length of the incoming PLDM request message.
 * @param resp Pointer to the buffer for the PLDM response message.
 * @param resp_len Pointer to the length of the response buffer; updated with actual response length
 * @return PLDM_SUCCESS on success, or appropriate PLDM error code on failure.
 */
int handle_platform_init_state_sensor(struct pldm_header_info *hdr, const void *req_msg, size_t req_len, void *resp, size_t *resp_len)
{
	// TODO: implement
	return PLDM_ERROR_UNSUPPORTED_PLDM_CMD;
}
```
