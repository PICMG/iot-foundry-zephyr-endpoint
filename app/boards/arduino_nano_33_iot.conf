## app/boards/arduino_nano_33_iot.conf
```kconfig
# Board-specific defaults for logging on CDC-ACM and MCTP on sercom5
# Enable USB device and CDC-ACM for the console/logging
CONFIG_USB_DEVICE_STACK_NEXT=y
CONFIG_USBD_CDC_ACM_CLASS=y
CONFIG_CDC_ACM_SERIAL_INITIALIZE_AT_BOOT=y

# Keep legacy USB device stack disabled; use `device_next` (USBD_) stack
CONFIG_USB_DEVICE_STACK=n

# Route console/shell to the chosen devicetree console (overlay sets CDC-ACM)
CONFIG_CONSOLE=y
CONFIG_PRINTK=y
CONFIG_STDOUT_CONSOLE=y

# MCTP + UART async support (used by mctp_uart binding)
CONFIG_SERIAL=y
CONFIG_USBD_CDC_ACM_WORKQUEUE=y
CONFIG_USBD_CDC_ACM_BUF_POOL=y
CONFIG_DMA=y
CONFIG_DMA_SAM0=y
CONFIG_UART_ASYNC_API=y
CONFIG_UART_SAM0_ASYNC=y
CONFIG_DMA_LOG_LEVEL_DBG=y
CONFIG_UART_INTERRUPT_DRIVEN=y
CONFIG_MCTP=y
CONFIG_MCTP_UART=y

# Logging buffer and ISR stack tuning
CONFIG_LOG=y
CONFIG_UDC_DRIVER_LOG_LEVEL_ERR=y
CONFIG_USBD_LOG_LEVEL_ERR=y
CONFIG_USBD_CDC_ACM_LOG_LEVEL_OFF=y
CONFIG_LOG_DEFAULT_LEVEL=3
CONFIG_LOG_BUFFER_SIZE=4096
CONFIG_KERNEL_LOG_LEVEL_INF=y
CONFIG_UART_LOG_LEVEL_DBG=y
# Use a smaller ISR stack to reduce noinit memory usage on SAMD21
CONFIG_ISR_STACK_SIZE=1024

# Enable the CDC-ACM serial backend at boot so the USB serial port
# is brought up early and can drain log output.
CONFIG_CDC_ACM_SERIAL_ENABLE_AT_BOOT=y
```
